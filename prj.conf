## CMakeLists.txt
```
cmake_minimum_required(VERSION 3.20.0)
set(CMAKE_CXX_STANDARD 20)

find_package(Zephyr REQUIRED)
set(CMAKE_EXPORT_COMPILE_COMMANDS ON)

project(control)
include_directories(${CMAKE_SOURCE_DIR}/include)
FILE(GLOB app_sources src/*.c)
target_sources(app PRIVATE ${app_sources})
```

## prj.conf
```kconfig
CONFIG_PRINTK=y
CONFIG_ARM_MPU=n
```

## app.overlay
```dts
/{
 app {
        #address-cells = <1>;
        #size-cells = <1>;
        pendulum0: pendulum@80000000 {
            status = "okay";
            compatible = "pendulum";
            reg = <0x80000000 0x1000>;
            label = "pendulum";
        };
    };
};
```

## src/main.c
```c
#include "driver.h"
#include "control.h"
#include "zephyr/device.h"
#include "zephyr/devicetree.h"
#include "zephyr/sys/printk.h"
#include <stdint.h>


int main() { 
    printk("Pendulum Controller on %s started\n", CONFIG_BOARD_TARGET);
    const struct device* pd = DEVICE_DT_GET(DT_NODELABEL(pendulum0));
    printk("Drivers: %p\n", (void*)pd);
    struct sensor_state sstate;
    struct pendulum_state pstate = {.k = 1 };
    struct control_interval con = {.ct = 20000, .su = 2000, .weight = 0.8, .xdist = 0.3, .sx = 0.4};
    float swing_up_str = 0.038f;
    float swing_up_smoother = 0.03f;
    uint32_t control_freq = 40000;
    pd_reset_api(pd);
    int32_t center = calibrate(pd, &sstate);
    wait(pd, &sstate, &pstate, 0.02, 0);
    pd_reset_api(pd);
    while(1){
        control(pd,&pstate, &sstate, &con, control_freq, swing_up_str, swing_up_smoother);
        printk("Button was hit\n");
        go_to(pd, &sstate, center);
    }
    return 0; 
}
```

## include/control.h
```c
#pragma once
#include "driver.h"
#include "zsl/vectors.h"
#include <zephyr/kernel.h>
#include <zsl/zsl.h>
#include <zsl/matrices.h>

#define WIDTH 4
typedef float vec4f[WIDTH];
typedef float mat4f[WIDTH][WIDTH];
struct pendulum_state {
  float x;      // cart position
  float dx;     // cart velocity
  float theta;  // pendulum angle
  float dtheta; // pendulum angular velocity

  float x_avg;      // averaged cart position
  float dx_avg;     // averaged cart velocity
  float theta_avg;  // averaged pendulum angle
  float dtheta_avg; // averaged pendulum angular velocity
  uint32_t k;       // length of data
};

struct control_interval {
  float su;
  uint32_t ct;
  float weight;
  float sx;
  float xdist;
};

struct matrix {
    vec4f k_hac;
    vec4f k_hpc;
    mat4f p_hac;
    mat4f p_hpc;
};

void init_matrix(struct matrix **mat);

void delete_matrix(struct matrix **mat);

void go_to(const struct device *pd, struct sensor_state *sstate,
           int32_t position);

void wait(const struct device *dev, struct sensor_state *sstate,
          struct pendulum_state *pstate, float dt, float force);

int32_t calibrate(const struct device *pd, struct sensor_state *sstate);

void control(const struct device *pd, struct pendulum_state *pstate,
             struct sensor_state *sstate, struct control_interval *con,
             uint32_t control_freq, float swing_up_str, float swing_up_smoother);
```

## include/driver.h
```c
#pragma once
#include "zephyr/device.h"
#include "zephyr/toolchain.h"
#include <stdint.h>
#define DT_DRV_COMPAT pendulum
#define PERIOD 1999980
#define MAX_PWM 2.0f
#define MIN_PWM 1.0f
struct sensor_state {
  int32_t pendulumAngle;
  int32_t cartPosition;
  int16_t buttons[2];
};

typedef int (*reset_fn)(const struct device *);
typedef int (*read_fn)(const struct device *, struct sensor_state *);
typedef int (*update_fn)(const struct device *, int32_t);

__subsystem struct pendulum_controller_driver_api {
  reset_fn reset;
  read_fn read;
  update_fn update_threshold;
};

static inline float clamp(float val, float min, float max) {
  if (val < min)
    return min;
  if (val > max)
    return max;
  return val;
}

static inline int pd_pwm_cfg(const struct device *dev, int32_t val) {
  const struct pendulum_controller_driver_api *api =
      DEVICE_API_GET(pendulum_controller, dev);
  return api->update_threshold(dev, val);
}

static inline void pd_read_api(const struct device *dev,
                               struct sensor_state *sstate) {
  const struct pendulum_controller_driver_api *api =
      (const struct pendulum_controller_driver_api *)dev->api;
  api->read(dev, sstate);
}

static inline void pd_update_threshold_api(const struct device *dev,
                                           float val) {
  float duty_cycle =(1.0f / 20.0f) * val + (MAX_PWM + MIN_PWM) / 2.0f;
  int32_t pwm = (int32_t)clamp(duty_cycle, MAX_PWM, MIN_PWM) / 20. * PERIOD;
  const struct pendulum_controller_driver_api *api =
      (const struct pendulum_controller_driver_api *)dev->api;
  api->update_threshold(dev, pwm);
}

static inline void pd_reset_api(const struct device *dev) {
  const struct pendulum_controller_driver_api *api =
      (const struct pendulum_controller_driver_api *)dev->api;
  api->reset(dev);
}
```

## src/control.c
```c
#include "control.h"
#include "driver.h"
#include "zephyr/device.h"
#include "zephyr/kernel.h"
#include "zephyr/sys_clock.h"
#include <math.h>
#include <stdbool.h>
#include <stdint.h>
#include <stdlib.h>
#include <zephyr/devicetree.h>
#include <zephyr/sys_clock.h>

#define M_PI 3.14159265358979323846f
#define PULSES_PER_MIN (2048 * 4)
#define TO_RADIANS (2 * M_PI / PULSES_PER_MIN)
#define MOTOR_RADIUS 0.0205f

static const float to_radians(int32_t value) { return value * TO_RADIANS; }
static const int32_t normalize(int32_t value) {
  int32_t threshold = PULSES_PER_MIN >> 1;
  value = value % PULSES_PER_MIN;
  if (value > threshold) {
    value -= PULSES_PER_MIN;
  } else if (value <= -threshold) {
    value += PULSES_PER_MIN;
  }
  return value;
}

static float dot(const vec4f *v1, const vec4f *v2) {
  float out = 0.0;
  for (int i = 0; i < 4; ++i) {
    out += (*v1)[i] * (*v2)[i];
  }
  return out;
}

static void pendulum_update(struct pendulum_state *pstate,
                            const struct sensor_state *state, const float dt,
                            const float force) {
  float position = to_radians(state->cartPosition) * MOTOR_RADIUS;
  float velocity = (position - pstate->k) / dt;
  float angle = to_radians(normalize(state->pendulumAngle));
  float angular_velocity = (angle - pstate->theta) / dt;

  pstate->x = position;
  pstate->dx = velocity;
  pstate->theta = angle;
  pstate->dtheta = angular_velocity;
}

static float compute_control(struct pendulum_state *pstate, const float force,
                             vec4f *m) {
  vec4f temp_x = {pstate->x, pstate->dx, pstate->theta, pstate->dtheta};
  return dot(&temp_x, m) * MOTOR_RADIUS;
}

static bool close(int32_t v1, int32_t v2) {
#define threshold 128
  return abs(v1 - v2) < threshold;
}

static float quadform(const vec4f *v, const mat4f *m){
    float sum = 0.0f;
    for(int i = 0; i < WIDTH; ++i){
        for(int j = 0; j < WIDTH; ++j){
            sum += (*v)[i] * (*m)[i][j] * (*v)[j];
        }
    }
    return sum;
}

static int sign(const float x) {
  if (x > 0)
    return 1;
  if (x < 0)
    return -1;
  return 0;
}

static float get_swing_up(struct pendulum_state *pstate, float swing_up_str, float swing_up_smoother) {
    return swing_up_str *
             (((0.06875f * pstate->dtheta * pstate->dtheta) + 2.69775f * (1.0f - cosf(pstate->theta))) *
              sign(pstate->dtheta * cosf(pstate->theta))) -
         swing_up_smoother * pstate->dtheta;

}

static float chooseController(struct pendulum_state *pstate, float force, struct matrix *m,
                              uint32_t* control_freq, float swing_up_str, float swing_up_smoother,
                              struct control_interval *con) {
   const vec4f tempState = {pstate->x, pstate->dx, pstate->theta, pstate->dtheta}; 
   if (fabsf(tempState[2]) > 0.6f) {
       *control_freq = con->su;
    return get_swing_up(pstate, swing_up_str, swing_up_smoother);
  } else if (quadform(&tempState, &m->p_hpc) < 1) {
    *control_freq = con->ct;
    return compute_control(pstate, force, &m->k_hpc);
  } else if (quadform(&tempState, &m->p_hac) < 1) {
    *control_freq = con->ct;
    return compute_control(pstate, force, &m->k_hac);
  } else {
    *control_freq = con->su;
    return get_swing_up(pstate, swing_up_str, swing_up_smoother);
  }
}

void go_to(const struct device *pd, struct sensor_state *sstate, int32_t position) {
  do {
    pd_read_api(pd, sstate);
    if (sstate->cartPosition > position) {
      pd_update_threshold_api(pd, -0.2);  
    } else if (sstate->cartPosition < position) {
      pd_update_threshold_api(pd, 0.2);
    }
  } while (abs(sstate->cartPosition - position) > 16);
  pd_update_threshold_api(pd, 0.0);
}

// for init
// do not call from main control loop
void wait(const struct device *dev, struct sensor_state *sstate,
          struct pendulum_state *pstate, float dt, float force) {
  {
    float old_theta = 90000;
    while (true) {
      k_timeout_t timeout = K_USEC(1000000);
      if (old_theta == pstate->theta) {
        break;
      }
      old_theta = pstate->theta;
      pd_read_api(dev, sstate);
      k_sleep(timeout);
      pendulum_update(pstate, sstate, dt, force);
    }
  }
}

void init_matrix(struct matrix **mat){
    *mat = malloc(sizeof(struct matrix));
    if(*mat == NULL){
        printk("Failed to allocate memory for matrix\n");
        exit(1);
    }
    (*mat)->k_hac[0] = 65.0;
    (*mat)->k_hac[1] = 112.0;
    (*mat)->k_hac[2] = -370.2;
    (*mat)->k_hac[3] = -38.5;
    (*mat)->k_hpc[0] = 58.37;
    (*mat)->k_hpc[1] = 80.74;
    (*mat)->k_hpc[2] = -319.45;
    (*mat)->k_hpc[3] = -27.29;
    
    (*mat)->p_hac[0][0] = 8.15119469;
    (*mat)->p_hac[0][1] = 2.8266167;
    (*mat)->p_hac[0][2] = -7.57358622;
    (*mat)->p_hac[0][3] = -0.96052152;

    (*mat)->p_hac[1][0] = 2.8266167;
    (*mat)->p_hac[1][1] = 3.7290751;
    (*mat)->p_hac[1][2] = -9.89565939;
    (*mat)->p_hac[1][3] = -1.2430829;

    (*mat)->p_hac[2][0] = -7.57358622;
    (*mat)->p_hac[2][1] = -9.89565939;
    (*mat)->p_hac[2][2] = 31.67548976;
    (*mat)->p_hac[2][3] = 3.36267636;

    (*mat)->p_hac[3][0] = -0.96052152;
    (*mat)->p_hac[3][1] = -1.2430829;
    (*mat)->p_hac[3][2] = 3.36267636;
    (*mat)->p_hac[3][3] = 0.43045142;

    (*mat)->p_hpc[0][0] = 2.71217664e+02;
    (*mat)->p_hpc[0][1] = 1.17166609e+01;
    (*mat)->p_hpc[0][2] = -4.22353808e+01;
    (*mat)->p_hpc[0][3] = -3.65636321e+00;

    (*mat)->p_hpc[1][0] = 1.17166609e+01;
    (*mat)->p_hpc[1][1] = 1.99733763e+00;
    (*mat)->p_hpc[1][2] = -7.12305739e+00;
    (*mat)->p_hpc[1][3] = -5.98773670e-01;

    (*mat)->p_hpc[2][0] = -4.22353808e+01;
    (*mat)->p_hpc[2][1] = -7.12305739e+00;
    (*mat)->p_hpc[2][2] = 2.94670562e+01;
    (*mat)->p_hpc[2][3] = 2.21976362e+00;

    (*mat)->p_hpc[3][0] = -3.65636321e+00;
    (*mat)->p_hpc[3][1] = -5.98773670e-01;
    (*mat)->p_hpc[3][2] = 2.21976362e+00;
    (*mat)->p_hpc[3][3] = 1.98118654e-01;

}

void delete_matrix(struct matrix **mat){
    free(*mat);
    *mat = NULL;
}

int32_t calibrate(const struct device *pd, struct sensor_state *sstate) {
  do {
    pd_read_api(pd, sstate);
    pd_update_threshold_api(pd, 0.2);
  } while (!sstate->buttons[0]);
  pd_update_threshold_api(pd, 0.0);
  int32_t cart_position = sstate->cartPosition;

  do {
    pd_read_api(pd, sstate);
    pd_update_threshold_api(pd, -0.2);
  } while (!sstate->buttons[1]);
  pd_update_threshold_api(pd, 0.0);
  int32_t cart_position2 = sstate->cartPosition;
  int32_t center = (cart_position + cart_position2) >> 1ll;

  do {
    pd_read_api(pd, sstate);
    pd_update_threshold_api(pd, 0.2);
  } while (!close(center, sstate->cartPosition));
  pd_update_threshold_api(pd, 0.0);
  return center;
}

void control(const struct device *pd, struct pendulum_state *pstate, struct sensor_state *sstate,
             struct control_interval *con, uint32_t control_freq, float swing_up_str, float swing_up_smoother) {
  float u = 0.0, elapsed = control_freq;
  struct matrix *m;
  init_matrix(&m);
  k_timeout_t timer, wait;
  k_timepoint_t left;
  timer = K_USEC(control_freq);
  while (1) {
    left = sys_timepoint_calc(timer);
    wait = sys_timepoint_timeout(left);
    k_sleep(wait);
    timer = K_USEC(control_freq);
    pd_read_api(pd, sstate);
    pendulum_update(pstate, sstate, elapsed, u);
    if(sstate->buttons[0] || sstate->buttons[1])
        break;
    u = chooseController(pstate, u,  m, &control_freq, swing_up_str, swing_up_smoother, con);
    pd_update_threshold_api(pd, u);
  }
    delete_matrix(&m);
}
```

## src/driver.c
```c
#include "driver.h"
#include "zephyr/app_memory/mem_domain.h"
#include "zephyr/arch/arm/mpu/arm_mpu.h"
#include "zephyr/sys/printk.h"
#include "zephyr/sys/sys_io.h"
#include <arm_acle.h>
#include <stdint.h>
#include <zephyr/device.h>
#include <zephyr/devicetree.h>
#include <zephyr/kernel.h>
#include <zephyr/sys/device_mmio.h>

#define PD_ENC_O_VAL 0
#define PD_ENC_0_RST 4
#define PD_ENC_1_VAL 8
#define PD_ENC_1_RST 12
#define PD_BUT_L 16
#define PD_BUT_R 18
#define PD_PWM 32

struct pd_data {
  DEVICE_MMIO_RAM;
};

struct pd_config {
  DEVICE_MMIO_ROM;
};

static int pd_reset(const struct device *dev) {
  mm_reg_t mmio = DEVICE_MMIO_GET(dev);
  printk("Resetting Encoders\n");
  sys_write32(0, mmio + PD_ENC_0_RST);
  sys_write32(0, mmio + PD_ENC_1_RST);
  printk("Reset Done\n");
  return 0;
}

static int pd_read(const struct device *dev, struct sensor_state *sstate) {
  mm_reg_t mmio = DEVICE_MMIO_GET(dev);
  sstate->cartPosition = sys_read32(mmio + PD_ENC_O_VAL);
  sstate->pendulumAngle = sys_read32(mmio + PD_ENC_1_VAL);
  sstate->buttons[0] = sys_read16(mmio + PD_BUT_L);
  sstate->buttons[1] = sys_read16(mmio + PD_BUT_R);
  return 0;
}

static int pd_update_threshold(const struct device *dev, int32_t threshold) {
  mm_reg_t mmio = DEVICE_MMIO_GET(dev);
  sys_write32(threshold, mmio + PD_PWM);
  return 0;
}

static int pd_init(const struct device *dev) {
  DEVICE_MMIO_MAP(dev, K_MEM_CACHE_NONE);
  mm_reg_t mmio = DEVICE_MMIO_GET(dev);
  printk("Allocating MMIO Region at %lx\n", mmio);
  return 0;
}

static struct pendulum_controller_driver_api pd_api = {.reset = pd_reset,
                                                       .read = pd_read,
                                                       .update_threshold =
                                                           pd_update_threshold};
static struct pd_data pd_data = {};
static struct pd_config pd_config = {
    DEVICE_MMIO_ROM_INIT(DT_NODELABEL(pendulum0)),
};
DEVICE_DT_DEFINE(DT_NODELABEL(pendulum0), pd_init, NULL, &pd_data, &pd_config,
                 PRE_KERNEL_2, CONFIG_KERNEL_INIT_PRIORITY_DEVICE, &pd_api);
```
